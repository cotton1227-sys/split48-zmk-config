## boards/shields/split48/Kconfig.defconfig
```kconfig
if SHIELD_SPLIT48_LEFT

config ZMK_KEYBOARD_NAME
    default "split48"

config ZMK_SPLIT_ROLE_CENTRAL
    default y

endif # SHIELD_SPLIT48_LEFT

if SHIELD_SPLIT48_LEFT || SHIELD_SPLIT48_RIGHT

config ZMK_SPLIT
    default y

endif # SHIELD_SPLIT48_LEFT || SHIELD_SPLIT48_RIGHT
```

## boards/shields/split48/Kconfig.shield
```kconfig
config SHIELD_SPLIT48_LEFT
    def_bool $(shields_list_contains,split48_left)

config SHIELD_SPLIT48_RIGHT
    def_bool $(shields_list_contains,split48_right)
```
